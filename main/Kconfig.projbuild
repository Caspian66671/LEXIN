## main/Kconfig.projbuild
```kconfig
config SLAVE_IDF_TARGET_ESP32C6
    bool
    default y if IDF_TARGET_ESP32P4

menu "LeXin Configuration"

    config LEXIN_WIFI_SSID
        string "WiFi SSID"
        default ""

    config LEXIN_WIFI_PASSWORD
        string "WiFi Password"
        default ""

    config LEXIN_WIFI_MAXIMUM_RETRY
        int "WiFi maximum retry"
        default 8

    config LEXIN_PROXY_BASE_URL
        string "Fast local proxy base URL"
        default "auto"

    config LEXIN_PROXY_PREFERRED_HOST
        string "Preferred fast proxy host IP"
        default "172.31.169.142"

    config LEXIN_PROXY_PORT
        int "Fast local proxy port"
        default 8787

endmenu
```

## sdkconfig.defaults
```kconfig
CONFIG_ESP_WIFI_REMOTE_LIBRARY_HOSTED=y
CONFIG_ESP_HOSTED_CP_TARGET_ESP32C6=y
CONFIG_ESP_HOSTED_P4_DEV_BOARD_FUNC_BOARD=y
CONFIG_ESP_HOSTED_SDIO_HOST_INTERFACE=y
CONFIG_ESPTOOLPY_FLASHSIZE_16MB=y
CONFIG_ESPTOOLPY_FLASHSIZE="16MB"
CONFIG_PARTITION_TABLE_CUSTOM=y
CONFIG_PARTITION_TABLE_CUSTOM_FILENAME="partitions.csv"
CONFIG_PARTITION_TABLE_FILENAME="partitions.csv"
CONFIG_LEXIN_WIFI_SSID=""
CONFIG_LEXIN_WIFI_PASSWORD=""
CONFIG_LEXIN_PROXY_BASE_URL="auto"
CONFIG_LEXIN_PROXY_PREFERRED_HOST=""
CONFIG_LEXIN_PROXY_PORT=8787
CONFIG_SPIRAM=y
CONFIG_SPIRAM_MODE_HEX=y
CONFIG_SPIRAM_SPEED_200M=y
CONFIG_CAMERA_SC2336=y
CONFIG_LV_FONT_FMT_TXT_LARGE=y
CONFIG_LV_USE_FONT_COMPRESSED=y
CONFIG_LV_FONT_MONTSERRAT_14=y
CONFIG_LV_FONT_MONTSERRAT_20=y
CONFIG_LV_FONT_MONTSERRAT_28=y
CONFIG_LV_FONT_MONTSERRAT_32=y
CONFIG_LV_FONT_MONTSERRAT_48=y
CONFIG_LV_FONT_DEFAULT_MONTSERRAT_14=y
```
